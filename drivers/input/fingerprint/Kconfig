## drivers/input/fingerprint/Kconfig
```kconfig
#
# Fingerprint driver configuration
#
menuconfig INPUT_FINGERPRINT
	bool "Fingerprints"
	help
	  Say Y here, and a list of supported fingerprints will be displayed.
	  This option doesn't affect the kernel.

	  If unsure, say Y.

if INPUT_FINGERPRINT

config FINGERPRINT_GOODIX_TA_CAPA
    bool "Goodix fingerprint CAPA driver"
    depends on INPUT_FINGERPRINT
    help
      Goodix fingerprint with capacitive array support.



source "drivers/input/fingerprint/goodix_ta/Kconfig"
source "drivers/input/fingerprint/fpc_tee/Kconfig"

endif
```

## drivers/input/touchscreen/xiaomi/Kconfig
```kconfig
source "drivers/input/touchscreen/xiaomi/fts_521/Kconfig"
source "drivers/input/touchscreen/xiaomi/goodix_driver_gt9886/Kconfig"
source "drivers/input/touchscreen/xiaomi/nt36523/Kconfig"
source "drivers/input/touchscreen/xiaomi/nt36672c/Kconfig"

config I2C_BY_DMA
	bool "I2C BY DMA"

config SECURE_TOUCH
	bool "Secure Touch"

config INPUT_PRESS_NDT
	bool "ndt"
	depends on I2C
	help
	  Say Y here if you have a press ic ndt.

config SPI_XIAOMI_TP
	bool
	depends on SPI
	default y if TOUCHSCREEN_NT36xxx_HOSTDL_SPI
	help
		Say Y if want use xiaomi touch panel.

# --- 来自 MiCode: 小米触控特性 ---
config TOUCHSCREEN_XIAOMI_TOUCHFEATURE
	tristate "Xiaomi touch feature"
	depends on INPUT_TOUCHSCREEN
	help
	  Enable Xiaomi touch feature support.

config TOUCHSCREEN_XIAOMI_TOUCHFEATURE_PALMSENSOR
	tristate "Xiaomi touch palm sensor"
	depends on TOUCHSCREEN_XIAOMI_TOUCHFEATURE

config TOUCHSCREEN_XIAOMI_TOUCHFEATURE_GAMEMODE
	tristate "Xiaomi touch game mode"
	depends on TOUCHSCREEN_XIAOMI_TOUCHFEATURE

# --- 来自 MiCode: 小米触控特性 ---
config TOUCHSCREEN_XIAOMI_TOUCHFEATURE
	tristate "Xiaomi touch feature"
	depends on INPUT_TOUCHSCREEN
	help
	  Enable Xiaomi touch feature support.

config TOUCHSCREEN_XIAOMI_TOUCHFEATURE_PALMSENSOR
	tristate "Xiaomi touch palm sensor"
	depends on TOUCHSCREEN_XIAOMI_TOUCHFEATURE

config TOUCHSCREEN_XIAOMI_TOUCHFEATURE_GAMEMODE
	tristate "Xiaomi touch game mode"
	depends on TOUCHSCREEN_XIAOMI_TOUCHFEATURE
```
